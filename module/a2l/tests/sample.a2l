ASAP2_VERSION 1 71
/* OpenScope 测试 A2L：配合 xcp_mock_slave（127.0.0.1:5555，内存 0x20000000..+64K） */
/begin PROJECT OpenScopeDemo "OpenScope XCP demo"
/begin HEADER "demo" VERSION "1.0" /end HEADER
/begin MODULE DemoEcu "Mock ECU"
/begin MOD_COMMON "" BYTE_ORDER MSB_LAST ALIGNMENT_BYTE 1 /end MOD_COMMON
/begin MOD_PAR "mock" EPK "OpenScope-XCP" ADDR_EPK 0x20000F00
 /begin MEMORY_SEGMENT Cal "Calibration" DATA FLASH INTERN 0x20000100 0x400 -1 -1 -1 -1 -1
  /begin IF_DATA XCP
   /begin SEGMENT 0 2 0 0 0 /begin CHECKSUM XCP_ADD_14 MAX_BLOCK_SIZE 0xFFFF /end CHECKSUM
    /begin PAGE 0 ECU_ACCESS_WITH_XCP_ONLY XCP_READ_ACCESS_WITH_ECU_ONLY XCP_WRITE_ACCESS_NOT_ALLOWED /end PAGE
    /begin PAGE 1 ECU_ACCESS_WITH_XCP_ONLY XCP_READ_ACCESS_WITH_ECU_ONLY XCP_WRITE_ACCESS_WITH_ECU_ONLY /end PAGE
   /end SEGMENT
  /end IF_DATA
 /end MEMORY_SEGMENT
 /begin MEMORY_SEGMENT Ram "Measurement RAM" VARIABLES RAM INTERN 0x20000000 0x100 -1 -1 -1 -1 -1 /end MEMORY_SEGMENT
/end MOD_PAR
/begin IF_DATA XCP
 /begin PROTOCOL_LAYER 0x0103 2000 2000 2000 2000 2000 2000 2000 /* version, T1..T7 */ 64 64 BYTE_ORDER_MSB_LAST ADDRESS_GRANULARITY_BYTE SEED_AND_KEY_EXTERNAL_FUNCTION "SeedKey_OpenScope.dll" OPTIONAL_CMD GET_SEED OPTIONAL_CMD UNLOCK OPTIONAL_CMD SET_CAL_PAGE OPTIONAL_CMD GET_CAL_PAGE COMMUNICATION_MODE_SUPPORTED BLOCK SLAVE MASTER 0x10 0x00 /end PROTOCOL_LAYER
 /begin DAQ DYNAMIC 8 2 0 OPTIMISATION_TYPE_DEFAULT ADDRESS_EXTENSION_FREE IDENTIFICATION_FIELD_TYPE_ABSOLUTE GRANULARITY_ODT_ENTRY_SIZE_DAQ_BYTE 7 NO_OVERLOAD_INDICATION PRESCALER_SUPPORTED /begin TIMESTAMP_SUPPORTED 1 SIZE_DWORD UNIT_1US TIMESTAMP_FIXED /end TIMESTAMP_SUPPORTED /begin EVENT "1ms" "1ms" 0 DAQ 8 1 6 0 /end EVENT /begin EVENT "10ms task" "10ms" 1 DAQ 8 10 6 1 /end EVENT /end DAQ
 /begin PAG 1 FREEZE_SUPPORTED /end PAG
 /begin XCP_ON_TCP_IP 0x0100 5555 ADDRESS "127.0.0.1" /end XCP_ON_TCP_IP
 /begin XCP_ON_UDP_IP 0x0100 5556 HOST_NAME "localhost" /end XCP_ON_UDP_IP
 /begin XCP_ON_CAN 0x0100 CAN_ID_BROADCAST 0x100 CAN_ID_MASTER 0x200 CAN_ID_SLAVE 0x300 BAUDRATE 500000
  /begin PROTOCOL_LAYER 0x0100 10 10 10 10 10 0 32 8 8 BYTE_ORDER_MSB_FIRST ADDRESS_GRANULARITY_BYTE OPTIONAL_CMD SHORT_UPLOAD /end PROTOCOL_LAYER
 /end XCP_ON_CAN
/end IF_DATA
/begin RECORD_LAYOUT RL_UWORD FNC_VALUES 1 UWORD ROW_DIR DIRECT /end RECORD_LAYOUT
/begin RECORD_LAYOUT RL_FLOAT FNC_VALUES 1 FLOAT32_IEEE ROW_DIR DIRECT /end RECORD_LAYOUT
/begin RECORD_LAYOUT RL_CURVE_STD NO_AXIS_PTS_X 1 UBYTE AXIS_PTS_X 2 UWORD INDEX_INCR DIRECT FNC_VALUES 3 SWORD COLUMN_DIR DIRECT /end RECORD_LAYOUT
/begin RECORD_LAYOUT RL_AXIS AXIS_PTS_X 1 UWORD INDEX_INCR DIRECT /end RECORD_LAYOUT
/begin COMPU_METHOD CM_ID "" IDENTICAL "%6.0" "" /end COMPU_METHOD
/begin COMPU_METHOD CM_rpm "engine speed" LINEAR "%8.2" "rpm" COEFFS_LINEAR 0.25 -100 /end COMPU_METHOD
/begin COMPU_METHOD CM_degC "temp" RAT_FUNC "%5.1" "degC" COEFFS 0 10 400 0 0 1 /end COMPU_METHOD
/begin COMPU_METHOD CM_form "formula" FORM "%6.3" "V" /begin FORMULA "X1*5/1024+0.5" FORMULA_INV "(X1-0.5)*1024/5" /end FORMULA /end COMPU_METHOD
/begin COMPU_METHOD CM_tab "map" TAB_INTP "%6.2" "kPa" COMPU_TAB_REF TAB_P /end COMPU_METHOD
/begin COMPU_METHOD CM_gear "gear" TAB_VERB "%d" "" COMPU_TAB_REF VT_GEAR /end COMPU_METHOD
/begin COMPU_METHOD CM_state "state" TAB_VERB "%d" "" COMPU_TAB_REF VTR_STATE /end COMPU_METHOD
/begin COMPU_TAB TAB_P "pressure" TAB_INTP 3 0 100.0 100 150.0 200 300.0 /end COMPU_TAB
/begin COMPU_VTAB VT_GEAR "gear text" TAB_VERB 4 0 "Neutral" 1 "First" 2 "Second" 3 "Third" DEFAULT_VALUE "Invalid" /end COMPU_VTAB
/begin COMPU_VTAB_RANGE VTR_STATE "state" 2 0 9 "Low" 10 99 "High" DEFAULT_VALUE "Out" /end COMPU_VTAB_RANGE
/begin MEASUREMENT counter "1ms counter" ULONG CM_ID 0 0 0 4294967295 ECU_ADDRESS 0x20000000 /end MEASUREMENT
/begin MEASUREMENT sine "sine" FLOAT32_IEEE NO_COMPU_METHOD 0 0 -1 1 ECU_ADDRESS 0x20000004 PHYS_UNIT "-" /end MEASUREMENT
/begin MEASUREMENT gear "gear" UBYTE CM_gear 0 0 0 3 ECU_ADDRESS 0x2000000A BIT_MASK 0x0F /end MEASUREMENT
/begin MEASUREMENT rpm "engine speed" UWORD CM_rpm 0 0 -100 16283.75 ECU_ADDRESS 0x2000000C /end MEASUREMENT
/begin CHARACTERISTIC idle_rpm "idle speed" VALUE 0x20000100 RL_UWORD 0 CM_rpm 0 2000 /end CHARACTERISTIC
/begin CHARACTERISTIC gain "gain" VALUE 0x20000104 RL_FLOAT 0 NO_COMPU_METHOD -10 10 /end CHARACTERISTIC
/begin CHARACTERISTIC ign_curve "ignition vs rpm" CURVE 0x20000110 RL_CURVE_STD 0 CM_ID -100 100 /begin AXIS_DESCR STD_AXIS rpm CM_rpm 8 0 8000 FORMAT "%6.0" /end AXIS_DESCR /end CHARACTERISTIC
/begin CHARACTERISTIC fuel_map "fuel map" MAP 0x20000200 RL_UWORD 0 CM_ID 0 65535 /begin AXIS_DESCR COM_AXIS rpm CM_rpm 6 0 8000 AXIS_PTS_REF ax_rpm /end AXIS_DESCR
 /begin AXIS_DESCR FIX_AXIS NO_INPUT_QUANTITY CM_ID 4 0 300 FIX_AXIS_PAR_DIST 0 100 4 /end AXIS_DESCR
/end CHARACTERISTIC
/begin CHARACTERISTIC lut "fixed list" CURVE 0x20000300 RL_UWORD 0 CM_ID 0 100
 /begin AXIS_DESCR FIX_AXIS NO_INPUT_QUANTITY CM_ID 3 0 50 /begin FIX_AXIS_PAR_LIST 0 10 50 /end FIX_AXIS_PAR_LIST /end AXIS_DESCR
/end CHARACTERISTIC
/begin CHARACTERISTIC name_str "string" ASCII 0x20000380 RL_UWORD 0 NO_COMPU_METHOD 0 255 NUMBER 16 READ_ONLY /end CHARACTERISTIC
/begin AXIS_PTS ax_rpm "rpm axis" 0x20000180 rpm RL_AXIS 0 CM_rpm 6 0 8000 /end AXIS_PTS
/begin GROUP Engine "Engine" ROOT /begin REF_CHARACTERISTIC idle_rpm ign_curve fuel_map /end REF_CHARACTERISTIC /begin REF_MEASUREMENT rpm gear /end REF_MEASUREMENT /begin SUB_GROUP Diag /end SUB_GROUP /end GROUP
/begin GROUP Diag "Diagnostics" /begin REF_MEASUREMENT counter sine /end REF_MEASUREMENT /end GROUP
/begin FUNCTION Ctrl "Controller" /begin DEF_CHARACTERISTIC gain /end DEF_CHARACTERISTIC /begin IN_MEASUREMENT rpm /end IN_MEASUREMENT /begin OUT_MEASUREMENT sine /end OUT_MEASUREMENT /end FUNCTION
/end MODULE
/end PROJECT
